## config/boards/shields/Kconfig.defconfig
```kconfig
if SHIELD_CREST_RIGHT

config ZMK_KEYBOARD_NAME
    default "Crest"

config ZMK_SPLIT_ROLE_CENTRAL
    default y

endif

if SHIELD_CREST_RIGHT || SHIELD_CREST_LEFT

config ZMK_SPLIT
    default y

endif
```

## config/boards/shields/Kconfig.shield
```kconfig
# No whitespace after the comma or in your part name!
config SHIELD_CREST_LEFT
    def_bool $(shields_list_contains,crest_left)

# No whitespace after the comma or in your part name!
config SHIELD_CREST_RIGHT
    def_bool $(shields_list_contains,crest_right)
```

## config/boards/shields/crest/Kconfig.defconfig
```kconfig
if SHIELD_CREST_DONGLE

config ZMK_KEYBOARD_NAME
    default "Crest"

config ZMK_SPLIT_ROLE_CENTRAL
    default y

endif

if SHIELD_CREST_LEFT || SHIELD_CREST_RIGHT || SHIELD_CREST_DONGLE

config ZMK_SPLIT
    default y

endif
```

## config/boards/shields/crest/Kconfig.shield
```kconfig
config SHIELD_CREST_LEFT
    def_bool $(shields_list_contains,crest_left)

config SHIELD_CREST_RIGHT
    def_bool $(shields_list_contains,crest_right)

config SHIELD_CREST_DONGLE
    def_bool $(shields_list_contains,crest_dongle)
```
